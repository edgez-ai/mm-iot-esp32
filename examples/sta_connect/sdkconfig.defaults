## examples/sta_connect/sdkconfig.defaults
```kconfig
CONFIG_LWIP_NETIF_LINK_CALLBACK=y
CONFIG_FREERTOS_HZ=1000

CONFIG_IDF_TARGET="esp32s3"

CONFIG_MBEDTLS_NIST_KW_C=y
CONFIG_ESPTOOLPY_FLASHSIZE_8MB=y
CONFIG_ESPTOOLPY_FLASHSIZE="8MB"
CONFIG_PARTITION_TABLE_CUSTOM=y
CONFIG_PARTITION_TABLE_CUSTOM_FILENAME="partitions.csv"
CONFIG_PARTITION_TABLE_FILENAME="partitions.csv"
```

## examples/sta_connect/sdkconfig.defaults.esp32s3
```kconfig
CONFIG_LWIP_NETIF_LINK_CALLBACK=y
#
# ESP32S3-specific
#
CONFIG_ESP32S3_INSTRUCTION_CACHE_32KB=y
```
